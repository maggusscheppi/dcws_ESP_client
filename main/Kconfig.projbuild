## main/Kconfig.projbuild
```kconfig
menu "Example Configuration"

    choice EXAMPLE_MODEM_DEVICE
        prompt "Choose supported modem device (DCE)"
        default EXAMPLE_MODEM_DEVICE_BG96
        help
            Select modem device connected to the ESP DTE.
        config EXAMPLE_MODEM_DEVICE_SIM800
            bool "SIM800"
            help
                SIMCom SIM800L is a GSM/GPRS module.
                It supports Quad-band 850/900/1800/1900MHz.
        config EXAMPLE_MODEM_DEVICE_BG96
            bool "BG96"
            help
                Quectel BG96 is a series of LTE Cat M1/Cat NB1/EGPRS module.
    endchoice

    config EXAMPLE_MODEM_APN
        string "Set Access Point Name (APN)"
        default "CMNET"
        help
            Logical name which is used to select the GGSN or the external packet data network.

    config EXAMPLE_MODEM_PPP_AUTH_USERNAME
        string "Set username for authentication"
        default "espressif"
        help
            Set username for PPP Authentication.

    config EXAMPLE_MODEM_PPP_AUTH_PASSWORD
        string "Set password for authentication"
        default "esp32"
        help
            Set password for PPP Authentication.

    config EXAMPLE_SEND_MSG
        bool "Short message (SMS)"
        default n
        help
            Select this, the modem will send a short message before power off.

    if EXAMPLE_SEND_MSG
        config EXAMPLE_SEND_MSG_PEER_PHONE_NUMBER
            string "Peer Phone Number (with area code)"
            default "+8610086"
            help
                Enter the peer phone number that you want to send message to.
    endif

    menu "UART Configuration"
        config EXAMPLE_UART_MODEM_TX_PIN
            int "TXD Pin Number"
            default 25
            range 0 31
            help
                Pin number of UART TX.

        config EXAMPLE_UART_MODEM_RX_PIN
            int "RXD Pin Number"
            default 26
            range 0 31
            help
                Pin number of UART RX.

        config EXAMPLE_UART_MODEM_RTS_PIN
            int "RTS Pin Number"
            default 27
            range 0 31
            help
                Pin number of UART RTS.

        config EXAMPLE_UART_MODEM_CTS_PIN
            int "CTS Pin Number"
            default 23
            range 0 31
            help
                Pin number of UART CTS.

        config EXAMPLE_UART_EVENT_TASK_STACK_SIZE
            int "UART Event Task Stack Size"
            range 2000 6000
            default 2048
            help
                Stack size of UART event task.

        config EXAMPLE_UART_EVENT_TASK_PRIORITY
            int "UART Event Task Priority"
            range 3 22
            default 5
            help
                Priority of UART event task.

        config EXAMPLE_UART_EVENT_QUEUE_SIZE
            int "UART Event Queue Size"
            range 10 40
            default 30
            help
                Length of UART event queue.

        config EXAMPLE_UART_PATTERN_QUEUE_SIZE
            int "UART Pattern Queue Size"
            range 10 40
            default 20
            help
                Length of UART pattern queue.

        config EXAMPLE_UART_TX_BUFFER_SIZE
            int "UART TX Buffer Size"
            range 256 2048
            default 512
            help
                Buffer size of UART TX buffer.

        config EXAMPLE_UART_RX_BUFFER_SIZE
            int "UART RX Buffer Size"
            range 256 2048
            default 1024
            help
                Buffer size of UART RX buffer.
    endmenu
	
    config NMEA_PARSER_RING_BUFFER_SIZE
        int "NMEA Parser Ring Buffer Size"
        range 0 2048
        default 1024
        help
            Size of the ring buffer used for UART Rx channel.

    config NMEA_PARSER_TASK_STACK_SIZE
        int "NMEA Parser Task Stack Size"
        range 0 4096
        default 2048
        help
            Stack size of NMEA Parser task.

    config NMEA_PARSER_TASK_PRIORITY
        int "NMEA Parser Task Priority"
        range 0 24
        default 2
        help
            Priority of NMEA Parser task.

    menu "NMEA Statement Support"
        comment "At least one statement must be selected"
        config NMEA_STATEMENT_GGA
            bool "GGA Statement"
            default y
            help
                Enabling this option will parse the following parameter from GGA statement:

                - Latitude, Longitude, Altitude;
                - Number of satellites in use, fix status (no fix, GPS, DGPS), UTC time;

        config NMEA_STATEMENT_GSA
            bool "GSA Statement"
            default y
            help
                Enabling this option will parse the following parameter from GSA statement:

                - Position/Vertical/Horizontal dilution of precision;
                - Fix mode (no fix, 2D, 3D fix);
                - IDs of satellites in use;

        config NMEA_STATEMENT_GSV
            bool "GSV Statement"
            default y
            help
                Enabling this option will parse the following parameter from GSV statement:

                - Number of satellites in view;
                - Optional details of each satellite in view;

        config NMEA_STATEMENT_RMC
            bool "RMC Statement"
            default y
            help
                Enabling this option will parse the following parameter from RMC statement:

                - Validity of GPS signal;
                - Ground speed (knots) and course over ground (degrees);
                - Magnetic variation;
                - UTC date;

        config NMEA_STATEMENT_GLL
            bool "GLL Statement"
            default y
            help
                Enabling this option will parse the following parameter from GLL statement:

                - Latitude, Longitude;
                - UTC time;

        config NMEA_STATEMENT_VTG
            bool "VTG Statement"
            default y
            help
                Enabling this option will parse the following parameter from VTG statement:

                - Ground speed (knots, km/h) and course over ground (degrees);
                - Magnetic variation;

    endmenu

endmenu
```
